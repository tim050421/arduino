#include <mcp_can_dfs.h>
#include <mcp_can.h>
#include <SPI.h>
#include <mcp_can.h>

#define CAN_MODULE_CS_PIN 10

#define CHECK_PERIOD_MS 200
#define ANNOUNCE_PERIOD_MS 50

MCP_CAN CAN(CAN_MODULE_CS_PIN);
#define CAN0_INT 2                              // Set INT to pin 2

unsigned long lastAnnounce = 0;
unsigned long millsTimer;

//unsigned char msgPowerOn[6]= {0x63,0,0,0,0,0};
unsigned char msgWakeUp[8] =   {0x58, 0x02,0,0,0,0,0,0 };
unsigned char msgWakeUpDr[8] = {0x0B, 0x02,0,0,0,0,0,0 };

void setup() {
  Serial.begin(250000);
  Serial.println("RR seats Enabler by TT v.1.1");

  while(CAN_OK != CAN.begin(CAN_83K3BPS, MCP_16MHz)) {
    Serial.println("CAN init fail");
    delay(250);
  }
  CAN.setMode(MODE_NORMAL);
//  CAN.init_Mask(0, 0, 0x000); 
//  CAN.init_Mask(1, 0, 0x000);
     
  Serial.println("CAN init ok");

//  CAN.sendMsgBuf(0x501, 0, 8, msgWakeUp);
  millsTimer = millis(); // Start millisecond timer

}

///////////////////////////// BrutForce!
unsigned int brut = 0x300;
unsigned char msgBrutZero[8] = {0x0,0x0,0,0,0,0,0,0};
unsigned char msgBrutFF[8] =   {0xff,0xff,0xff,0xff,0xff,0xff,0xff,0xff};

unsigned int msgIds[1] = {0x20};
unsigned char msgs[1][8] = {
                            {0x0, 0x0, 0x1, 0xF, 0xB2, 0x10, 0x0, 0x0}
                           };

// Disable seat operations from module 0x3ca
unsigned char msgDisableSeat[8] = {0x00,0x00,0x00,0x00,0x00,0xff,0x00,0x00};
/////////////////////////////

int i = 0;

void sendAnnouncements() {
/*    if(brut < 0x400) {
      if(brut != 0x3ca) { // This code seems able to turn seats off
        CAN.sendMsgBuf(brut, 0, 8, msgBrutFF);
      }
      Serial.print("Sent to: 0x"); Serial.println(brut, HEX);
      brut++;
      delay(60);
    } */
  unsigned int pIds[38] = {0x10, 0x15, 0x20, 0x30, 0x3a, 0xe0, 0xfa, 
                           0x114,0x12e,0x148,0x162,0x196,0x1b0,0x1d0,0x1d8,0x1ff, 
                           0x210,0x216,0x219,0x221,0x233,/*0x24d,*/0x267,0x281,0x29a,0x2b8,
                           /*0x311*/0x310,0x326,0x35c,0x378,0x3a2,0x3b2,0x3ca,0x3f0,
                           0x439,0x48c,0x495,0x4fa,0x4fc};
  unsigned char pData[38][8] = {
    {0xE0, 0x0, 0x0, 0xF0, 0x39, 0x0, 0x32, 0xE4}, // 0x10
    {0x10, 0x0, 0x0, 0x4, 0x80, 0x0, 0x80, 0x0},   // 0x15
    {0x0, 0x0, 0x1, 0xF, 0xB2, 0x10, 0x0, 0x0},    // 0x20 5-th byte can be 0xb1 or 0xb3
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    {0x10, 0x0, 0x0, 0x0, 0x0, 0x12, 0x40, 0x58},  // 0x233
//    {0x20, 0x0, 0x0, 0x0, 0x0, 0x0, 0x3F, 0xFF},   // 0x24d Driver seat state command (5-th byte 0x0 or 0x20)
    {0x82, 0x2, 0x7D, 0xA0, 0xC, 0xC9, 0x2, 0x0},  // 0x267
    {0x90, 0x0, 0x0, 0x20, 0x0, 0x50, 0xA0, 0x0},  // 0x281
    {0x0, 0x80, 0x0, 0x1, 0x0, 0x0, 0x1E, 0x78},   // 0x29a
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    {0x0, 0x0, 0x0, 0x0, 0x0, 0x0, 0xC0, 0x0}      // 0x4fc    
  };

  unsigned char p400[89][8] = {
    {0x1, 0x12, 0x2, 0x2, 0x1, 0x9B, 0x2, 0xC},
    {0x2, 0x1, 0x50, 0x2, 0x0, 0x4, 0x1, 0x3},
    {0x3, 0x0, 0x2, 0x0, 0x4, 0x0, 0x0, 0x2},
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    {0xB1, 0x0, 0x82, 0xF4, 0x48, 0x3C, 0xFF, 0xFF} //? Timer slow
  };

  unsigned char p405[6][8] = {
    {0x1, 0x64, 0x3B, 0x35, 0x1B, 0x24, 0x60, 0xA1},
    {0x2, 0x48, 0x3C, 0x0, 0x31, 0x0, 0x82, 0xF4},
    {0x5, 0x0, 0x0, 0x0, 0x0, 0x0, 0x8, 0x78},
    {0x10, 0x0, 0x0, 0x0, 0x0, 0x53, 0x41, 0x4C},
    {0x11, 0x43, 0x41, 0x32, 0x42, 0x4E, 0x31, 0x4A},
    {0x12, 0x48, 0x37, 0x35, 0x39, 0x35, 0x30, 0x38}
  };

  unsigned char p407[25][8] = {
    {0x1, 0x8, 0x1, 0x25, 0x53, 0x41, 0x4C, 0x43},
    {0x2, 0x41, 0x32, 0x42, 0x4E, 0x31, 0x4A, 0x48},
    {0x3, 0x37, 0x35, 0x39, 0x35, 0x30, 0x38, 0x2},
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    {0x1C, 0x0, 0x1, 0x4, 0x0, 0x8A, 0x0, 0x90}
  };

// Send commands from Discovery dump except 0x4xx  
/*  if(i < 38) {
    if(pIds[i] == 0x148){ // Millisecond timer
      unsigned long ms = (millis() - millsTimer)/100;
      pData[i][3] = (unsigned char)ms & 0xFF;
      pData[i][2] = (unsigned char)ms >> 8 & 0xFF;
//      pData[i][1] = (unsigned char)ms >> 16 & 0xFF;
    }
    if(pIds[i] == 0x35c){ // Seconds timer
      unsigned long sec = (millis() - millsTimer)/1000;
      pData[i][7] = (unsigned char)sec & 0xFF;
      pData[i][6] = (unsigned char)sec >> 8 & 0xFF;
    }

    CAN.sendMsgBuf(pIds[i], 0, 8, pData[i]);
    i++;
    delay(6);
// Send 0x4xx commands from Discovery dump 
  } else { i = 0; } 
    if(i < 44) {
      CAN.sendMsgBuf(0x405, 0, 8, p405[i-38]);
      i++;
      delay(6);
    } else if(i < 69) {
      CAN.sendMsgBuf(0x407, 0, 8, p407[i-44]);
      i++;
      delay(6);
      Serial.println("All sent");
    } 
  } 
  if(i < 89) {
      CAN.sendMsgBuf(0x400, 0, 8, p400[i]);
      i++;
      delay(8);
      Serial.print(".");
  } else if(i < 95) {
      CAN.sendMsgBuf(0x405, 0, 8, p405[i-89]);
      i++;
      delay(8);
      Serial.print(",");
  } else if(i < 115) {
      CAN.sendMsgBuf(0x407, 0, 8, p407[i-90]);
      i++;
      delay(6);
      Serial.print(".");
  } else { i = 0; } */
}

void checkIncomingMessages() {
  static unsigned int canId = 0;
  static unsigned char len = 0;
  static unsigned char buf[12];
  static byte err2;
  static unsigned char newMsg[7];
  
  if(CAN_MSGAVAIL == CAN.checkReceive()) {
    CAN.readMsgBuf(&len, buf);
  }
  else {
    return;
  }
  canId = CAN.getCanId();

  switch (canId) {
/*    case 0x01b: // VIN code
      Serial.println("VIN received");
      break;
    case 0x558: // Wake up module and not allow to sleep
      if(buf[1] == 0x1){
        CAN.sendMsgBuf(0x501, 0, 8, msgWakeUp);        
//        Serial.println("Awaike received");
        delay(80);
      }
      break;
    case 0x50B: // Right (driver) seat wakeup
      if(buf[1] == 0x1){
        CAN.sendMsgBuf(0x501, 0, 8, msgWakeUpDr);
//        Serial.println("Awaike received");
        delay(80);
      }
      break; 
    case 0x310: // Seat heartbeat? codes
    case 0x311:
      break;
    case 0x24D:
    case 0x378:
//      if(buf[0] == 0 && buf[1] == 0 && buf[2] == 0 && buf[3] == 0 && buf[4] == 0 && buf[5] == 0)
      if(buf[5] == 0)
        break;
      for (int i = 0; i < 1; i++){
        unsigned char b[8] = {0x0, 0x0, 0x0, 0x0, 0x0, 0x1F, 0x59, 0x52};
        CAN.sendMsgBuf(0x3ca, 0, 8, b);
        delay(20);
      } 
      Serial.println("Commands received");
      break; */
    case 0xA0:
      Serial.print("Key position signal detected!!! -> 0x");
      Serial.println(buf[0],HEX);
      break;
    default:
          Serial.print("{ \"id\": \"0x"); Serial.print(canId, HEX);
          Serial.print("\", \"len\": "); Serial.print(len);
          Serial.print(", \"value\": [");
          for(int i=0; i<len; i++) {
            if(i > 0)
              Serial.print("\",");
            Serial.print(" \"0x"); Serial.print(buf[i], HEX);
          }
          Serial.println("\" ] }"); 
      break;
  }
}

void loop() {
//  if (millis() > lastAnnounce + ANNOUNCE_PERIOD_MS) {
//    lastAnnounce = millis();
//    sendAnnouncements();
//  }
  checkIncomingMessages();
}
